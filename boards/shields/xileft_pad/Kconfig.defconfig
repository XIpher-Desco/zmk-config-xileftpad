## boards/shields/xileft_pad/Kconfig.shield
```kconfig
# Copyright (c) 2026 Xiphelier
# SPDX-License-Identifier: MIT

config SHIELD_XILEFT_PAD
    def_bool $(shields_list_contains,xileft_pad)
```

## boards/shields/xileft_pad_ipad/Kconfig.shield
```kconfig
# Copyright (c) 2026 Xiphelier
# SPDX-License-Identifier: MIT

config SHIELD_XILEFT_PAD_IPAD
    def_bool $(shields_list_contains,xileft_pad_ipad)
```

## boards/shields/xileft_pad_pintest/Kconfig.defconfig
```kconfig
# SPDX-License-Identifier: MIT

if SHIELD_XILEFT_PAD_PINTEST

config ZMK_KEYBOARD_NAME
    default "xileft pintest"

endif
```

## boards/shields/xileft_pad_pintest/Kconfig.shield
```kconfig
# SPDX-License-Identifier: MIT

config SHIELD_XILEFT_PAD_PINTEST
    def_bool $(shields_list_contains,xileft_pad_pintest)
```

## boards/shields/xileft_pad_v2/Kconfig.shield
```kconfig
# Copyright (c) 2026 Xiphelier
# SPDX-License-Identifier: MIT

config SHIELD_XILEFT_PAD_V2
    def_bool $(shields_list_contains,xileft_pad_v2)
```
